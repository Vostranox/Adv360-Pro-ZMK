## config/west.yml
```yaml
manifest:
  remotes:
    - name: zmkfirmware
      url-base: https://github.com/zmkfirmware
    - name: Vostranox
      url-base: https://github.com/Vostranox
  projects:
    - name: zmk
      remote: Vostranox
      revision: held_stacked_sticky_keys
      import: app/west.yml
  self:
    path: config
```
